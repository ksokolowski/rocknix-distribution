## projects/ROCKNIX/devices/RK3128/packages/u-boot/sources/board/powkiddy/a12-rk3128/Kconfig
```kconfig
if TARGET_POWKIDDY_A12_RK3128

config SYS_BOARD
	default "a12-rk3128"

config SYS_VENDOR
	default "powkiddy"

config SYS_CONFIG_NAME
	default "powkiddy-a12-rk3128"

config A12_DISPLAY
	bool "A12 RGB panel on the RK3128 VOP (draft, unverified)"
	depends on VIDEO && DM_GPIO
	help
	  Light the A12 revision A panel in U-Boot (VOP lite, TTL PHY, panel
	  power sequence, PWM backlight) for a logo before Linux. Not verified
	  on hardware; only powkiddy-a12-display-rk3128_defconfig enables it.

endif
```

## projects/ROCKNIX/devices/RK3128/packages/u-boot/sources/configs/powkiddy-a12-display-rk3128_defconfig
```kconfig
CONFIG_ARM=y
CONFIG_SKIP_LOWLEVEL_INIT=y
CONFIG_SYS_ARCH_TIMER=y
CONFIG_ARCH_ROCKCHIP=y
CONFIG_TEXT_BASE=0x60000000
CONFIG_SYS_MALLOC_F_LEN=0x38000
CONFIG_NR_DRAM_BANKS=2
CONFIG_HAS_CUSTOM_SYS_INIT_SP_ADDR=y
CONFIG_CUSTOM_SYS_INIT_SP_ADDR=0x60100000
CONFIG_DEFAULT_DEVICE_TREE="rockchip/rk3128-powkiddy-a12-rev-a-display"
CONFIG_DM_RESET=y
CONFIG_ROCKCHIP_RK3128=y
CONFIG_TARGET_POWKIDDY_A12_RK3128=y
# CONFIG_ARMV7_NONSEC is not set
# CONFIG_ARMV7_VIRT is not set
CONFIG_SYS_BOOTM_LEN=0x4000000
CONFIG_SYS_LOAD_ADDR=0x60800800
CONFIG_DEBUG_UART_BASE=0x20060000
CONFIG_DEBUG_UART_CLOCK=24000000
# CONFIG_DEBUG_UART_BOARD_INIT is not set
CONFIG_DEBUG_UART=y
CONFIG_BOOTDELAY=0
CONFIG_DEFAULT_FDT_FILE="device_trees/rk3128-powkiddy-a12-rev-a.dtb"
CONFIG_BOOTSTD_DEFAULTS=y
# CONFIG_EFI_LOADER is not set
# CONFIG_NET is not set
# CONFIG_TOOLS_MKEFICAPSULE is not set
# CONFIG_DISPLAY_CPUINFO is not set
CONFIG_DISPLAY_BOARDINFO_LATE=y
CONFIG_CMD_BOOTZ=y
CONFIG_CMD_MMC=y
CONFIG_CMD_TIME=y
CONFIG_CMD_FAT=y
CONFIG_CMD_FS_GENERIC=y
CONFIG_DOS_PARTITION=y
CONFIG_ENV_IS_NOWHERE=y
CONFIG_SYSCON=y
CONFIG_CLK=y
CONFIG_ROCKCHIP_GPIO=y
CONFIG_MMC_DW=y
CONFIG_MMC_DW_ROCKCHIP=y
CONFIG_PINCTRL=y
CONFIG_DM_REGULATOR=y
CONFIG_DM_REGULATOR_FIXED=y
CONFIG_RAM=y
CONFIG_DEBUG_UART_SHIFT=2
CONFIG_SYS_NS16550_MEM32=y
CONFIG_SYSRESET=y
CONFIG_ERRNO_STR=y
# B3 draft: panel and logo in U-Boot (board/powkiddy/a12-rk3128/a12-display.c).
CONFIG_VIDEO=y
CONFIG_VIDEO_LOGO=y
CONFIG_VIDEO_BPP32=y
CONFIG_A12_DISPLAY=y
CONFIG_DM_PWM=y
CONFIG_PWM_ROCKCHIP=y
CONFIG_BACKLIGHT_PWM=y
```
